## deploy/iso/minikube-iso/arch/x86_64/package/containerd-bin/Config.in
```kconfig
config BR2_PACKAGE_CONTAINERD_BIN
	bool "containerd-bin"
	default y
	depends on BR2_x86_64
	depends on BR2_TOOLCHAIN_HAS_THREADS
	select BR2_PACKAGE_RUNC_MASTER
	select BR2_PACKAGE_BTRFS_PROGS
	select BR2_PACKAGE_LIBSECCOMP
	select BR2_PACKAGE_LIBGPGME
	select BR2_PACKAGE_LVM2
	select BR2_PACKAGE_UTIL_LINUX_LIBMOUNT
	select BR2_PACKAGE_LIBGLIB2
```
